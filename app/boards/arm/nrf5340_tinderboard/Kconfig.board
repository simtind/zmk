## app/boards/arm/nrf5340_tinderboard/Kconfig.board
```kconfig
# nRF5340 Tinderboard NRF5340 board configuration

# Copyright (c) 2019-2020 Nordic Semiconductor ASA
# SPDX-License-Identifier: Apache-2.0

if SOC_NRF5340_CPUAPP_QKAA

config BOARD_TINDERBOARD_NRF5340_CPUAPP
	bool "Tinderboard nRF5340 Application MCU"

config BOARD_TINDERBOARD_NRF5340_CPUAPP_NS
	bool "Tinderboard nRF5340 Application MCU non-secure"

endif # SOC_NRF5340_CPUAPP_QKAA

config BOARD_TINDERBOARD_NRF5340_CPUNET
	bool "Tinderboard NRF5340 Network MCU"
	depends on SOC_NRF5340_CPUNET_QKAA
```

## app/src/display/Kconfig
```kconfig
# Copyright (c) 2020 The ZMK Contributors
# SPDX-License-Identifier: MIT

menuconfig ZMK_DISPLAY
    bool "Enable ZMK Display"
    default n
    select DISPLAY
    select LVGL
	select LV_USE_THEME_MONO

if ZMK_DISPLAY

choice LV_TXT_ENC
    default LV_TXT_ENC_UTF8

endchoice

choice ZMK_DISPLAY_STATUS_SCREEN
    prompt "Default status screen for displays"

config ZMK_DISPLAY_STATUS_SCREEN_BUILT_IN
    bool "Built in status screen"
    select LV_USE_LABEL

config ZMK_DISPLAY_STATUS_SCREEN_CUSTOM
    bool "Custom status screen"

endchoice

choice ZMK_DISPLAY_WORK_QUEUE
    prompt "Work queue selection for UI updates"

config ZMK_DISPLAY_WORK_QUEUE_SYSTEM
    bool "Use default system work queue for UI updates"

config ZMK_DISPLAY_WORK_QUEUE_DEDICATED
    bool "Use dedicated work queue for UI updates"

endchoice

if ZMK_DISPLAY_WORK_QUEUE_DEDICATED

config ZMK_DISPLAY_DEDICATED_THREAD_STACK_SIZE
    int "Stack size for dedicated UI thread/queue"
    default 2048

config ZMK_DISPLAY_DEDICATED_THREAD_PRIORITY
    int "Thread priority for dedicated UI thread/queue"
    default 5

endif # ZMK_DISPLAY_WORK_QUEUE_DEDICATED

if ZMK_DISPLAY_STATUS_SCREEN_BUILT_IN

config LV_FONT_MONTSERRAT_16
    default y

choice LV_FONT_DEFAULT
    default LV_FONT_DEFAULT_MONTSERRAT_16

endchoice

endif # ZMK_DISPLAY_STATUS_SCREEN_BUILT_IN

rsource "widgets/Kconfig"

endif
```
